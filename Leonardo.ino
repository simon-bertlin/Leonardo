
#include <Keyboard.h>
const unsigned short sleepTime[] PROGMEM = {136, 130, 166, 118, 164, 148, 194, 150, 224, 164, 93, 77, 132, 219, 194, 95, 66, 78, 16, 91, 132, 168, 57, 172, 
162, 47, 165, 165, 178, 211, 194, 132, 133, 163, 241, 184, 125, 141, 180, 184, 200, 274, 166, 16, 156, 233, 195, 179, 270, 
163, 116, 148, 54, 148, 188, 180, 243, 155, 112, 227, 219, 134, 199, 214, 133, 211, 104, 196, 194, 159, 160, 148, 242, 110, 
181, 163, 81, 164, 105, 258, 145, 178, 120, 165, 157, 125, 163, 44, 94, 94, 210, 172, 149, 146, 211, 227, 166, 141, 245, 
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179, 78, 194, 195, 119, 128, 140, 127, 156, 114, 138, 116, 148, 132, 147, 116, 55};

const unsigned short releaseTime[] PROGMEM = {66, 
58, 49, 94, 98, 56, 99, 105, 102, 96, 56, 66, 87, 101, 83, 51, 136, 136, 71, 70, 148, 75, 47, 102, 85, 73, 
106, 74, 76, 71, 87, 89, 52, 32, 57, 90, 73, 69, 61, 64, 120, 63, 88, 91, 89, 66, 75, 102, 123, 71, 59, 
105, 60, 53, 99, 106, 52, 47, 69, 64, 86, 57, 102, 73, 59, 31, 89, 110, 43, 91, 72, 63, 100, 56, 104, 0, 
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98, 71, 55, 72, 89, 134, 19, 88, 60, 85, 57, 132, 86, 55, 78};


const unsigned short sizeOfSleepTime = sizeof(sleepTime) / sizeof(sleepTime[0]);
const unsigned short sizeOfReleaseTime = sizeof(releaseTime) / sizeof(releaseTime[0]);
unsigned long timeSinceLastLoot = millis();
unsigned long lootTimer = 120000;

const unsigned char timer = 'v';
const unsigned char destroyButton = 'p'; //usually 0
const unsigned char lootButt = '2';
const unsigned char extraButton = 'p'; // usually . 
const unsigned char mainSkill = ',';
const unsigned char disabledSign = 'p';


bool isRunning = true;

void setup() {
  pinMode(2, INPUT_PULLUP);
  Keyboard.begin();

}

void loop() {
  //Do nothing until we cable is pulled.
  while (digitalRead(2)) {
    delay(500);
  }
  timeSinceLastLoot = millis();
  isRunning = true;
  while(isRunning){
    runLoop();
    int distract = random(1,10);
    if(distract == 1){
      distracted();
    }
  }
}

void runLoop(){
    int offsetPress = random(45,130);
    int offsetRelease = random(10,45);
    for(byte index = 0; index < sizeOfSleepTime && index < sizeOfReleaseTime; index++){
      Keyboard.press(mainSkill);
      delay(pgm_read_word_near(sleepTime + index) + offsetRelease);
      Keyboard.release(mainSkill);
      delay(pgm_read_word_near(sleepTime + index) + offsetPress);
      if(digitalRead(2)){
        return;
      }
      if(millis() - timeSinceLastLoot >= lootTimer){
        if(!loot()){
          return;
        }
      }
  }
}

void distracted(){
  short int distractedTime = random(5000,10000);
  unsigned long previousTime = millis();
  while(1){
    if(millis() - previousTime >= distractedTime){
      break;
    }
    if(digitalRead(2)){
      isRunning = false;
      break;
    }
  }
}


bool loot(){
  const unsigned short sleepLootTime[] = {84, 110, 105, 139, 121, 129, 168, 170, 211, 177, 160, 119, 151, 179, 140, 191, 189, 198, 202, 170, 157, 211, 142, 199, 
  184, 184, 145, 233, 169, 209, 209, 197, 202, 209, 189, 231};
  const unsigned short releaseLootTime[] = {24, 60, 34, 35, 38, 64, 52, 47, 43, 92, 49, 48, 64, 74, 29, 51, 78, 75, 91, 54, 64, 76, 42, 81, 79, 58, 79, 97, 76,
  78, 67, 91, 90, 100, 78, 55, 45, 91};
  const unsigned short sizeOfLootArray = sizeof(sleepLootTime) / sizeof(sleepLootTime[0]);
  const unsigned short sizeOfLootReleaseTime = sizeof(releaseLootTime) / sizeof(releaseLootTime[0]);
  
  int offsetPress = random(50,150);
  int offsetRelease = random(10,55);
  for(int index = 1; index < sizeOfLootArray && index < sizeOfLootReleaseTime; index++){
    Keyboard.press(lootButt);
    delay(releaseLootTime[index] + offsetRelease);
    Keyboard.release(lootButt);
    delay(sleepLootTime[index] + offsetPress);
    if(digitalRead(2)){
      timeSinceLastLoot = millis();
      return false;
     }
  }
  
  timeSinceLastLoot = millis();
  lootTimer = random(110000,120000);
  if(extraButton != disabledSign){
    pushExtraButton();
  }
  toggleIngameTimer();
  if(destroyButton != disabledSign){
    destroy();
  }
  return true;
}

void pushExtraButton(){
  Keyboard.press(extraButton);
  delay(random(50,80));
  Keyboard.release(extraButton);
  delay(random(100,400));
}

void destroy(){
 int destroyChance = random(1,10);
 if(destroyChance <= 7){
  Keyboard.press(destroyButton);
  delay(random(45,95));
  Keyboard.release(destroyButton);
  delay(random(100,350));
 }
}

void toggleIngameTimer(){
 int destroyChance = random(1,10);
 if(destroyChance <= 9){
  Keyboard.press(timer);
  delay(random(45,95));
  Keyboard.release(timer);
  delay(random(100,350));
 }
}
